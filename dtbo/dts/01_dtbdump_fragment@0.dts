/dts-v1/;

/ {

	fragment@0 {
		target = <0xffffffff>;

		__overlay__ {
			atag,videolfb-fb_base_h = <0x00>;
			atag,videolfb-fb_base_l = "^`P";
			atag,videolfb-islcmfound = <0x01>;
			atag,videolfb-islcm_inited = <0x00>;
			atag,videolfb-fps = <0x1770>;
			atag,videolfb-vramSize = <0x17bb000>;
			atag,videolfb-lcmname = "hx83102e_wuxga_dsi_vdo_txd";
		};
	};

	fragment@1 {
		target = <0xffffffff>;

		__overlay__ {

			led@0 {
				compatible = "mediatek,red";
				led_mode = <0x00>;
				data = <0x01>;
				pwm_config = <0x00 0x00 0x00 0x00 0x00>;
				phandle = <0x3a>;
			};

			led@1 {
				compatible = "mediatek,green";
				led_mode = <0x00>;
				data = <0x01>;
				pwm_config = <0x00 0x00 0x00 0x00 0x00>;
				phandle = <0x3b>;
			};

			led@2 {
				compatible = "mediatek,blue";
				led_mode = <0x00>;
				data = <0x01>;
				pwm_config = <0x00 0x00 0x00 0x00 0x00>;
				phandle = <0x3c>;
			};

			led@3 {
				compatible = "mediatek,jogball-backlight";
				led_mode = <0x00>;
				data = <0x01>;
				pwm_config = <0x00 0x00 0x00 0x00 0x00>;
				phandle = <0x3d>;
			};

			led@4 {
				compatible = "mediatek,keyboard-backlight";
				led_mode = <0x00>;
				data = <0x01>;
				pwm_config = <0x00 0x00 0x00 0x00 0x00>;
				phandle = <0x3e>;
			};

			led@5 {
				compatible = "mediatek,button-backlight";
				led_mode = <0x00>;
				data = <0x01>;
				pwm_config = <0x00 0x00 0x00 0x00 0x00>;
				phandle = <0x3f>;
			};

			led@6 {
				compatible = "mediatek,lcd-backlight";
				led_mode = <0x05>;
				data = <0x01>;
				pwm_config = <0x00 0x00 0x00 0x00 0x00>;
				phandle = <0x40>;
			};

			panel@0 {
				compatible = "boe,nt51021hwuxga";
				gpio_lcd_rst = <0xffffffff 0x2d 0x00>;
				gpio_lcd_led_en = <0xffffffff 0x9a 0x00>;
				gpio_lcd_pwr_enp = <0xffffffff 0xa7 0x00>;
				gpio_lcd_pwr_enn = <0xffffffff 0xa8 0x00>;
				pinctrl-names = "disp_pwm\0disp_pwm_gpio";
				pinctrl-0 = <0x01>;
				pinctrl-1 = <0x02>;
				phandle = <0x41>;
			};

			vibrator@0 {
				compatible = "mediatek,vibrator";
				vib_timer = <0x19>;
				vib_limit = <0x09>;
				vib_vol = <0x09>;
				phandle = <0x42>;
			};
		};
	};

	fragment@2 {
		target = <0xffffffff>;

		__overlay__ {

			lcd_disp_pwm {
				phandle = <0x01>;

				pins_cmd_dat {
					pinmux = <0x2b01>;
				};
			};

			lcd_disp_pwm_gpio {
				phandle = <0x02>;

				pins_cmd_dat {
					pinmux = <0x2b00>;
					output-low;
				};
			};
		};
	};

	fragment@3 {
		target = <0xffffffff>;

		__overlay__ {

			ext_buck_lp4@57 {
				regulator-name = "ext_buck_vdd2";
				regulator-min-microvolt = <0x493e0>;
				regulator-max-microvolt = <0x13d620>;
				vsel_pin = <0x00>;
			};

			ext_buck_lp4x@50 {
				regulator-name = "ext_buck_vddq";
				regulator-min-microvolt = <0x493e0>;
				regulator-max-microvolt = <0x13d620>;
				vsel_pin = <0x01>;
			};
		};
	};

	fragment@4 {
		target = <0xffffffff>;

		__overlay__ {

			ext_buck_vgpu@55 {
				regulator-name = "ext_buck_vgpu";
				regulator-min-microvolt = <0x493e0>;
				regulator-max-microvolt = <0x13d620>;
				vsel_pin = <0x02>;
			};
		};
	};

	fragment@5 {
		target = <0xffffffff>;

		__overlay__ {

			sgm7220@47 {
				status = "ok";
				reg = <0x47>;
				compatible = "sgmicro,sgm7220";
				interrupt-parent = <0xffffffff>;
				interrupts = <0x09 0x02>;
				sgm7220,int-gpio = <0xffffffff 0x09 0x00>;
				sgm7220,int-gpio_num = <0x09>;
			};

			wusb3801@60 {
				compatible = "semi,wusb3801";
				reg = <0x60>;
				interrupt-parent = <0xffffffff>;
				interrupts = <0x09 0x02>;
				wusb3801,int-gpio = <0xffffffff 0x09 0x00>;
				wusb3801,int-gpio_num = <0x09>;
				wusb3801,host-current = <0x01>;
				wusb3801,drp-toggle-time = <0x28>;
				status = "okay";
			};
		};
	};

	fragment@6 {
		target = <0xffffffff>;

		__overlay__ {

			consys_default {
				phandle = <0x03>;
			};

			gpslna@0 {
				phandle = <0x04>;

				pins_cmd_dat {
					pinmux = <0x5b00>;
					slew-rate = <0x00>;
					bias-disable;
					output-low;
				};
			};

			gpslna@1 {
				phandle = <0x05>;

				pins_cmd_dat {
					pinmux = <0x5b00>;
					slew-rate = <0x01>;
					output-high;
				};
			};

			gpslna@2 {
				phandle = <0x06>;

				pins_cmd_dat {
					pinmux = <0x5b00>;
					slew-rate = <0x01>;
					output-low;
				};
			};
		};
	};

	fragment@7 {
		target = <0xffffffff>;

		__overlay__ {
			pinctrl-names = "default\0gps_lna_state_init\0gps_lna_state_oh\0gps_lna_state_ol";
			pinctrl-0 = <0x03>;
			pinctrl-1 = <0x04>;
			pinctrl-2 = <0x05>;
			pinctrl-3 = <0x06>;
			status = "okay";
		};
	};

	fragment@8 {
		target = <0xffffffff>;

		__overlay__ {
			accdet-mic-vol = <0x06>;
			headset-mode-setting = <0x500 0x500 0x01 0x1f0 0x800 0x800 0x20 0x44>;
			accdet-plugout-debounce = <0x01>;
			accdet-mic-mode = <0x01>;
			headset-eint-level-pol = <0x08>;
			headset-three-key-threshold = <0x00 0x50 0xdc 0x190>;
			headset-three-key-threshold-CDD = <0x00 0x79 0xc0 0x258>;
			headset-four-key-threshold = <0x00 0x3a 0x79 0xc0 0x190>;
			pinctrl-names = "default\0state_eint_as_int";
			pinctrl-0 = <0x07>;
			pinctrl-1 = <0x08>;
			status = "okay";
		};
	};

	fragment@9 {
		target = <0xffffffff>;

		__overlay__ {

			accdetdefault {
				phandle = <0x07>;
			};

			accdeteint@0 {
				phandle = <0x08>;

				pins_cmd_dat {
					pinmux = <0x900>;
					slew-rate = <0x00>;
					bias-disable;
				};
			};
		};
	};

	fragment@10 {
		target = <0xffffffff>;

		__overlay__ {
			#address-cells = <0x01>;
			#size-cells = <0x00>;

			fingerprint@0 {
				compatible = "goodix,goodix-fp";
				reg = <0x00>;
				spi-max-frequency = <0x7a1200>;
				netlink-event = <0x1e>;
				status = "okay";
			};
		};
	};

	fragment@11 {
		target = <0xffffffff>;

		__overlay__ {
			pinctrl-names = "default\0reset_high\0reset_low";
			pinctrl-0 = <0x09>;
			pinctrl-1 = <0x0a>;
			pinctrl-2 = <0x0b>;
			status = "okay";
		};
	};

	fragment@12 {
		target = <0xffffffff>;

		__overlay__ {

			state_default {
				phandle = <0x09>;
			};

			state_reset_high {
				phandle = <0x0a>;

				pins_cmd_dat {
					pinmux = <0xac00>;
					slew-rate = <0x01>;
					output-high;
				};
			};

			state_reset_low {
				phandle = <0x0b>;

				pins_cmd_dat {
					pinmux = <0xac00>;
					slew-rate = <0x01>;
					output-low;
				};
			};
		};
	};

	fragment@13 {
		target = <0xffffffff>;

		__overlay__ {
			pinctrl-names = "irtx_gpio_led_default\0irtx_gpio_led_set";
			pinctrl-0 = <0x0c>;
			pinctrl-1 = <0x0d>;
			status = "okay";
		};
	};

	fragment@14 {
		target = <0xffffffff>;

		__overlay__ {

			irtx_gpio_led_def@gpio90 {
				phandle = <0x0c>;

				pins_cmd_dat {
					pinmux = <0x5a00>;
					slew-rate = <0x01>;
					bias-disable;
					output-low;
					input-schmitt-enable = <0x00>;
				};
			};

			irtx_gpio_led_set@gpio90 {
				phandle = <0x0d>;

				pins_cmd_dat {
					pinmux = <0x5a02>;
					slew-rate = <0x01>;
					output-high;
				};
			};
		};
	};

	fragment@15 {
		target = <0xffffffff>;

		__overlay__ {
			pinctrl-names = "aud_clk_mosi_off\0aud_clk_mosi_on\0aud_clk_miso_off\0aud_clk_miso_on\0aud_dat_mosi_off\0aud_dat_mosi_on\0aud_dat_miso_off\0aud_dat_miso_on\0aud_smartpa_off\0aud_smartpa_on";
			pinctrl-0 = <0x0e>;
			pinctrl-1 = <0x0f>;
			pinctrl-2 = <0x10>;
			pinctrl-3 = <0x11>;
			pinctrl-4 = <0x12>;
			pinctrl-5 = <0x13>;
			pinctrl-6 = <0x14>;
			pinctrl-7 = <0x15>;
			pinctrl-8 = <0x16>;
			pinctrl-9 = <0x17>;
			status = "okay";
		};
	};

	fragment@16 {
		target = <0xffffffff>;

		__overlay__ {

			aud_clk_mosi_off {
				phandle = <0x0e>;

				pins_cmd0_dat {
					pinmux = <0x8800>;
				};
			};

			aud_clk_mosi_on {
				phandle = <0x0f>;

				pins_cmd0_dat {
					pinmux = <0x8801>;
				};
			};

			aud_clk_miso_off {
				phandle = <0x10>;

				pins_cmd0_dat {
					pinmux = <0x8c00>;
				};
			};

			aud_clk_miso_on {
				phandle = <0x11>;

				pins_cmd0_dat {
					pinmux = <0x8c01>;
				};
			};

			aud_dat_mosi_off {
				phandle = <0x12>;

				pins_cmd1_dat {
					pinmux = <0x8a00>;
					input-enable;
					slew-rate = <0x00>;
					bias-disable;
				};

				pins_cmd2_dat {
					pinmux = <0x8b00>;
					input-enable;
					slew-rate = <0x00>;
					bias-disable;
				};
			};

			aud_dat_mosi_on {
				phandle = <0x13>;

				pins_cmd1_dat {
					pinmux = <0x8a01>;
				};

				pins_cmd2_dat {
					pinmux = <0x8b01>;
				};
			};

			aud_dat_miso_off {
				phandle = <0x14>;

				pins_cmd1_dat {
					pinmux = <0x8e00>;
					input-enable;
					slew-rate = <0x00>;
					bias-disable;
				};

				pins_cmd2_dat {
					pinmux = <0x8f00>;
					input-enable;
					slew-rate = <0x00>;
					bias-disable;
				};
			};

			aud_dat_miso_on {
				phandle = <0x15>;

				pins_cmd1_dat {
					pinmux = <0x8e01>;
				};

				pins_cmd2_dat {
					pinmux = <0x8f01>;
				};
			};

			aud_pins_smartpa_off {
				phandle = <0x16>;

				pins_cmd0_dat {
					pinmux = <0x1100>;
				};

				pins_cmd1_dat {
					pinmux = <0x1200>;
				};

				pins_cmd2_dat {
					pinmux = <0x1300>;
				};

				pins_cmd3_dat {
					pinmux = <0x1400>;
				};
			};

			aud_pins_smartpa_on {
				phandle = <0x17>;

				pins_cmd0_dat {
					pinmux = <0x1106>;
				};

				pins_cmd1_dat {
					pinmux = <0x1206>;
				};

				pins_cmd2_dat {
					pinmux = <0x1306>;
				};

				pins_cmd3_dat {
					pinmux = <0x1406>;
				};
			};
		};
	};

	fragment@17 {
		target = <0xffffffff>;

		__overlay__ {
			pinctrl-names = "default";
			pinctrl-0 = <0x18>;
		};
	};

	fragment@18 {
		target = <0xffffffff>;

		__overlay__ {

			kpdgpiodefault {
				phandle = <0x18>;

				pins_cmd_dat {
					pinmux = <0x5d01>;
					bias-pull-up = <0x66>;
					output-low;
					input-schmitt-enable;
				};
			};
		};
	};

	fragment@19 {
		target = <0xffffffff>;

		__overlay__ {

			flashlights_sywt78 {
				compatible = "mediatek,flashlights_sywt78";
				pinctrl-names = "default\0flash_low\0flash_high\0torch_low\0torch_high";
				pinctrl-0 = <0x19>;
				pinctrl-1 = <0x1a>;
				pinctrl-2 = <0x1b>;
				status = "okay";
				phandle = <0x43>;
			};
		};
	};

	fragment@20 {
		target = <0xffffffff>;

		__overlay__ {

			flash_default {
				phandle = <0x19>;
			};

			torch_en_pin0 {
				phandle = <0x1a>;

				pins_cmd_dat {
					pinmux = <0xb000>;
					slew-rate = <0x01>;
					output-low;
				};
			};

			torch_en_pin1 {
				phandle = <0x1b>;

				pins_cmd_dat {
					pinmux = <0xb000>;
					slew-rate = <0x01>;
					output-high;
				};
			};
		};
	};

	fragment@21 {
		target = <0xffffffff>;

		__overlay__ {

			adc_channel@ {
				compatible = "mediatek,adc_channel";
				mediatek,temperature0 = <0x00>;
				mediatek,temperature1 = <0x01>;
				mediatek,adc_fdd_rf_params_dynamic_custom_ch = <0x02>;
				status = "okay";
			};
		};
	};

	fragment@22 {
		target = <0xffffffff>;

		__overlay__ {
			io-channels = <0xffffffff 0x02>;
		};
	};

	fragment@23 {
		target = <0xffffffff>;

		__overlay__ {
			mediatek,clkbuf-quantity = <0x07>;
			mediatek,clkbuf-config = <0x02 0x01 0x01 0x02 0x00 0x00 0x00>;
			mediatek,clkbuf-driving-current = <0x01 0x01 0x01 0x01 0x01 0x01 0x01>;
			status = "okay";
		};
	};

	fragment@24 {
		target = <0xffffffff>;

		__overlay__ {
			#address-cells = <0x01>;
			#size-cells = <0x00>;
			clock-frequency = <0x61a80>;
			mediatek,use-push-pull;

			cap_touch@38 {
				compatible = "mediatek,cap_touch";
				reg = <0x38>;
				status = "okay";
				phandle = <0x44>;
			};
		};
	};

	fragment@25 {
		target = <0xffffffff>;

		__overlay__ {
			#address-cells = <0x01>;
			#size-cells = <0x00>;
			clock-frequency = <0x61a80>;
			mediatek,use-open-drain;
		};
	};

	fragment@26 {
		target = <0xffffffff>;

		__overlay__ {
			#address-cells = <0x01>;
			#size-cells = <0x00>;
			clock-frequency = <0x61a80>;
			mediatek,use-open-drain;

			camera_main@1a {
				compatible = "mediatek,camera_main";
				reg = <0x1a>;
				status = "okay";
				phandle = <0x45>;
			};

			camera_main_eeprom@50 {
				compatible = "mediatek,camera_main_eeprom";
				reg = <0x50>;
				status = "okay";
				phandle = <0x46>;
			};

			camera_main_af@0c {
				compatible = "mediatek,camera_main_af";
				reg = <0x0c>;
				status = "okay";
				phandle = <0x47>;
			};

			ccu_sensor_i2c_2_hw@10 {
				compatible = "mediatek,ccu_sensor_i2c_2_hw";
				reg = <0x10>;
				status = "okay";
				phandle = <0x48>;
			};
		};
	};

	fragment@27 {
		target = <0xffffffff>;

		__overlay__ {
			#address-cells = <0x01>;
			#size-cells = <0x00>;
			clock-frequency = <0x61a80>;
			mediatek,use-open-drain;

			speaker_amp@34 {
				compatible = "mediatek,speaker_amp";
				reg = <0x34>;
				status = "okay";
				phandle = <0x49>;
			};

			slave_charger@4b {
				compatible = "mediatek,slave_charger";
				reg = <0x4b>;
				status = "okay";
				phandle = <0x4a>;
			};

			nfc@08 {
				compatible = "mediatek,nfc";
				reg = <0x08>;
				status = "okay";
				phandle = <0x4b>;
			};

			ext_buck_lp4@57 {
				compatible = "mediatek,ext_buck_lp4";
				reg = <0x57>;
				status = "okay";
				phandle = <0x4c>;
			};

			ext_buck_lp4x@50 {
				compatible = "mediatek,ext_buck_lp4x";
				reg = <0x50>;
				status = "okay";
				phandle = <0x4d>;
			};
		};
	};

	fragment@28 {
		target = <0xffffffff>;

		__overlay__ {
			#address-cells = <0x01>;
			#size-cells = <0x00>;
			clock-frequency = <0x61a80>;
			mediatek,use-open-drain;

			camera_sub@2e {
				compatible = "mediatek,camera_sub";
				reg = <0x2e>;
				status = "okay";
				phandle = <0x4e>;
			};

			camera_sub_eeprom@52 {
				compatible = "mediatek,camera_sub_eeprom";
				reg = <0x52>;
				status = "okay";
				phandle = <0x4f>;
			};

			ccu_sensor_i2c_4_hw@11 {
				compatible = "mediatek,ccu_sensor_i2c_4_hw";
				reg = <0x11>;
				status = "okay";
				phandle = <0x50>;
			};
		};
	};

	fragment@29 {
		target = <0xffffffff>;

		__overlay__ {
			#address-cells = <0x01>;
			#size-cells = <0x00>;
			clock-frequency = <0x61a80>;
			mediatek,use-open-drain;
		};
	};

	fragment@30 {
		target = <0xffffffff>;

		__overlay__ {
			#address-cells = <0x01>;
			#size-cells = <0x00>;
			clock-frequency = <0x61a80>;
			mediatek,use-open-drain;

			camera_main_two@2d {
				compatible = "mediatek,camera_main_two";
				reg = <0x2d>;
				status = "okay";
				phandle = <0x51>;
			};

			camera_main_two_eeprom@50 {
				compatible = "mediatek,camera_main_two_eeprom";
				reg = <0x50>;
				status = "okay";
				phandle = <0x52>;
			};

			camera_main_two_af@0c {
				compatible = "mediatek,camera_main_two_af";
				reg = <0x0c>;
				status = "okay";
				phandle = <0x53>;
			};

			ext_buck_vgpu@55 {
				compatible = "mediatek,ext_buck_vgpu";
				reg = <0x55>;
				status = "okay";
				phandle = <0x54>;
			};
		};
	};

	fragment@31 {
		target = <0xffffffff>;

		__overlay__ {
			#address-cells = <0x01>;
			#size-cells = <0x00>;
			clock-frequency = <0x61a80>;
			mediatek,use-open-drain;
		};
	};

	fragment@32 {
		target = <0xffffffff>;

		__overlay__ {
			#address-cells = <0x01>;
			#size-cells = <0x00>;
			clock-frequency = <0x61a80>;
			mediatek,use-open-drain;
		};
	};

	fragment@33 {
		target = <0xffffffff>;

		__overlay__ {
			#address-cells = <0x01>;
			#size-cells = <0x00>;
			clock-frequency = <0x61a80>;
			mediatek,use-open-drain;
		};
	};

	fragment@34 {
		target = <0xffffffff>;

		__overlay__ {
			GPIO_SIM2_SIO = <0xffffffff 0x23 0x00>;
			GPIO_SIM2_SRST = <0xffffffff 0x24 0x00>;
			GPIO_SIM2_SCLK = <0xffffffff 0x25 0x00>;
			GPIO_SIM1_SCLK = <0xffffffff 0x26 0x00>;
			GPIO_SIM1_SRST = <0xffffffff 0x27 0x00>;
			GPIO_SIM1_SIO = <0xffffffff 0x28 0x00>;
			GPIO_SIM2_HOT_PLUG = <0xffffffff 0x2e 0x00>;
			GPIO_SIM1_HOT_PLUG = <0xffffffff 0x2f 0x00>;
		};
	};

	fragment@35 {
		target = <0xffffffff>;

		__overlay__ {
			gpio_init_default = <0x00 0x00 0x00 0x00 0x01 0x01 0x01 0x01 0x00 0x00 0x00 0x01 0x01 0x01 0x02 0x00 0x00 0x00 0x00 0x00 0x01 0x03 0x00 0x01 0x00 0x00 0x00 0x00 0x04 0x00 0x00 0x00 0x01 0x00 0x00 0x05 0x00 0x00 0x00 0x01 0x01 0x00 0x06 0x00 0x00 0x00 0x01 0x01 0x00 0x07 0x00 0x00 0x00 0x01 0x01 0x00 0x08 0x00 0x01 0x00 0x00 0x00 0x00 0x09 0x00 0x00 0x00 0x01 0x01 0x00 0x0a 0x00 0x00 0x00 0x01 0x00 0x00 0x0b 0x00 0x00 0x00 0x01 0x01 0x00 0x0c 0x00 0x00 0x00 0x01 0x00 0x00 0x0d 0x03 0x00 0x00 0x01 0x00 0x00 0x0e 0x03 0x01 0x00 0x00 0x00 0x00 0x0f 0x03 0x01 0x00 0x00 0x00 0x00 0x10 0x03 0x01 0x00 0x00 0x00 0x00 0x11 0x06 0x00 0x00 0x01 0x00 0x00 0x12 0x06 0x01 0x00 0x00 0x00 0x00 0x13 0x06 0x01 0x00 0x00 0x00 0x00 0x14 0x06 0x01 0x00 0x00 0x00 0x00 0x15 0x01 0x00 0x00 0x00 0x01 0x00 0x16 0x01 0x01 0x00 0x00 0x00 0x00 0x17 0x01 0x01 0x00 0x00 0x00 0x00 0x18 0x01 0x01 0x00 0x00 0x00 0x00 0x19 0x03 0x00 0x00 0x01 0x01 0x00 0x1a 0x03 0x00 0x00 0x01 0x01 0x00 0x1b 0x03 0x01 0x00 0x00 0x00 0x00 0x1c 0x00 0x01 0x01 0x01 0x01 0x00 0x1d 0x01 0x01 0x00 0x00 0x00 0x01 0x1e 0x01 0x00 0x00 0x01 0x01 0x01 0x1f 0x01 0x00 0x00 0x01 0x01 0x01 0x20 0x01 0x00 0x00 0x01 0x01 0x01 0x21 0x01 0x00 0x00 0x01 0x01 0x01 0x22 0x01 0x00 0x00 0x01 0x01 0x01 0x23 0x01 0x00 0x00 0x01 0x01 0x00 0x24 0x01 0x01 0x00 0x00 0x00 0x00 0x25 0x01 0x01 0x00 0x00 0x00 0x00 0x26 0x01 0x01 0x00 0x00 0x00 0x00 0x27 0x01 0x01 0x00 0x00 0x00 0x00 0x28 0x01 0x00 0x00 0x01 0x01 0x00 0x29 0x00 0x00 0x00 0x01 0x01 0x00 0x2a 0x00 0x00 0x00 0x01 0x00 0x00 0x2b 0x01 0x01 0x00 0x00 0x00 0x00 0x2c 0x00 0x00 0x00 0x01 0x00 0x00 0x2d 0x00 0x01 0x00 0x00 0x00 0x00 0x2e 0x01 0x00 0x00 0x01 0x01 0x00 0x2f 0x01 0x00 0x00 0x01 0x01 0x00 0x30 0x01 0x00 0x00 0x01 0x01 0x01 0x31 0x01 0x00 0x00 0x01 0x01 0x01 0x32 0x01 0x00 0x00 0x01 0x01 0x01 0x33 0x01 0x00 0x00 0x01 0x01 0x01 0x34 0x01 0x01 0x00 0x01 0x00 0x00 0x35 0x01 0x01 0x00 0x01 0x00 0x00 0x36 0x01 0x01 0x00 0x01 0x00 0x00 0x37 0x01 0x01 0x00 0x01 0x00 0x00 0x38 0x01 0x01 0x00 0x01 0x00 0x00 0x39 0x01 0x01 0x00 0x01 0x00 0x00 0x3a 0x00 0x00 0x00 0x01 0x00 0x00 0x3b 0x01 0x00 0x00 0x01 0x00 0x00 0x3c 0x01 0x00 0x00 0x01 0x00 0x00 0x3d 0x01 0x00 0x00 0x01 0x00 0x00 0x3e 0x01 0x00 0x00 0x01 0x00 0x00 0x3f 0x01 0x00 0x00 0x01 0x00 0x00 0x40 0x01 0x00 0x00 0x01 0x00 0x00 0x41 0x01 0x00 0x00 0x01 0x00 0x00 0x42 0x01 0x00 0x00 0x01 0x00 0x00 0x43 0x01 0x00 0x00 0x01 0x00 0x00 0x44 0x01 0x00 0x00 0x01 0x00 0x00 0x45 0x01 0x01 0x00 0x01 0x00 0x00 0x46 0x01 0x01 0x00 0x01 0x00 0x00 0x47 0x01 0x01 0x00 0x01 0x00 0x00 0x48 0x01 0x01 0x00 0x01 0x00 0x00 0x49 0x01 0x01 0x00 0x01 0x00 0x00 0x4a 0x01 0x01 0x00 0x01 0x00 0x00 0x4b 0x01 0x01 0x00 0x01 0x00 0x00 0x4c 0x01 0x01 0x00 0x01 0x00 0x00 0x4d 0x01 0x01 0x00 0x01 0x00 0x00 0x4e 0x01 0x01 0x00 0x01 0x00 0x00 0x4f 0x01 0x00 0x00 0x01 0x00 0x00 0x50 0x01 0x00 0x00 0x01 0x00 0x00 0x51 0x01 0x00 0x00 0x01 0x01 0x01 0x52 0x01 0x00 0x00 0x01 0x01 0x01 0x53 0x01 0x00 0x00 0x01 0x01 0x01 0x54 0x01 0x00 0x00 0x01 0x01 0x01 0x55 0x01 0x01 0x00 0x01 0x00 0x00 0x56 0x01 0x01 0x00 0x01 0x00 0x00 0x57 0x00 0x01 0x01 0x00 0x00 0x00 0x58 0x00 0x01 0x00 0x01 0x00 0x00 0x59 0x01 0x00 0x00 0x01 0x00 0x00 0x5a 0x02 0x01 0x00 0x00 0x00 0x00 0x5b 0x00 0x01 0x00 0x01 0x00 0x00 0x5c 0x00 0x00 0x00 0x01 0x01 0x00 0x5d 0x01 0x00 0x00 0x01 0x01 0x00 0x5e 0x00 0x00 0x00 0x01 0x00 0x00 0x5f 0x01 0x00 0x00 0x01 0x01 0x00 0x60 0x01 0x01 0x00 0x00 0x00 0x00 0x61 0x00 0x01 0x00 0x00 0x00 0x00 0x62 0x00 0x01 0x00 0x00 0x00 0x00 0x63 0x01 0x01 0x00 0x00 0x00 0x00 0x64 0x01 0x01 0x00 0x00 0x00 0x00 0x65 0x00 0x01 0x01 0x00 0x00 0x00 0x66 0x00 0x01 0x01 0x00 0x00 0x00 0x67 0x01 0x00 0x00 0x01 0x01 0x01 0x68 0x01 0x00 0x00 0x01 0x01 0x01 0x69 0x01 0x00 0x00 0x01 0x01 0x01 0x6a 0x01 0x00 0x00 0x01 0x01 0x01 0x6b 0x02 0x01 0x00 0x00 0x00 0x00 0x6c 0x01 0x01 0x00 0x00 0x00 0x00 0x6d 0x02 0x00 0x00 0x01 0x01 0x00 0x6e 0x00 0x00 0x00 0x01 0x00 0x00 0x6f 0x00 0x00 0x00 0x01 0x00 0x00 0x70 0x00 0x00 0x00 0x01 0x00 0x00 0x71 0x00 0x00 0x00 0x01 0x00 0x00 0x72 0x00 0x00 0x00 0x01 0x00 0x00 0x73 0x00 0x00 0x00 0x01 0x00 0x00 0x74 0x00 0x00 0x00 0x01 0x00 0x00 0x75 0x00 0x00 0x00 0x01 0x00 0x00 0x76 0x00 0x00 0x00 0x01 0x00 0x00 0x77 0x00 0x00 0x00 0x01 0x00 0x00 0x78 0x00 0x00 0x00 0x01 0x00 0x00 0x79 0x00 0x00 0x00 0x01 0x00 0x00 0x7a 0x01 0x00 0x00 0x01 0x01 0x01 0x7b 0x01 0x00 0x00 0x01 0x01 0x01 0x7c 0x01 0x01 0x00 0x00 0x00 0x01 0x7d 0x01 0x00 0x00 0x01 0x01 0x01 0x7e 0x01 0x00 0x00 0x01 0x01 0x01 0x7f 0x01 0x00 0x00 0x01 0x01 0x01 0x80 0x01 0x00 0x00 0x01 0x01 0x01 0x81 0x01 0x00 0x00 0x01 0x01 0x01 0x82 0x01 0x00 0x00 0x01 0x01 0x01 0x83 0x01 0x00 0x00 0x01 0x00 0x01 0x84 0x01 0x00 0x00 0x01 0x01 0x01 0x85 0x01 0x01 0x01 0x00 0x00 0x01 0x86 0x01 0x00 0x00 0x01 0x00 0x01 0x87 0x01 0x01 0x00 0x00 0x00 0x00 0x88 0x01 0x01 0x00 0x00 0x00 0x00 0x89 0x01 0x01 0x00 0x00 0x00 0x00 0x8a 0x01 0x01 0x00 0x00 0x00 0x00 0x8b 0x01 0x01 0x00 0x00 0x00 0x00 0x8c 0x01 0x00 0x00 0x01 0x00 0x00 0x8d 0x01 0x00 0x00 0x01 0x00 0x00 0x8e 0x01 0x00 0x00 0x01 0x00 0x00 0x8f 0x01 0x00 0x00 0x01 0x00 0x00 0x90 0x01 0x00 0x00 0x01 0x00 0x00 0x91 0x01 0x01 0x01 0x00 0x00 0x00 0x92 0x01 0x00 0x00 0x01 0x00 0x00 0x93 0x01 0x01 0x00 0x00 0x00 0x00 0x94 0x01 0x01 0x00 0x00 0x00 0x00 0x95 0x01 0x01 0x00 0x00 0x00 0x00 0x96 0x00 0x01 0x00 0x00 0x00 0x00 0x97 0x06 0x01 0x00 0x00 0x00 0x00 0x98 0x05 0x00 0x00 0x01 0x01 0x00 0x99 0x05 0x01 0x00 0x00 0x00 0x00 0x9a 0x00 0x01 0x00 0x00 0x00 0x00 0x9b 0x07 0x01 0x00 0x00 0x00 0x00 0x9c 0x07 0x00 0x00 0x01 0x00 0x00 0x9d 0x07 0x00 0x00 0x01 0x00 0x00 0x9e 0x07 0x00 0x00 0x01 0x00 0x00 0x9f 0x00 0x01 0x00 0x00 0x00 0x00 0xa0 0x00 0x01 0x00 0x00 0x00 0x00 0xa1 0x01 0x00 0x00 0x01 0x01 0x01 0xa2 0x01 0x00 0x00 0x01 0x01 0x01 0xa3 0x00 0x01 0x00 0x00 0x00 0x00 0xa4 0x00 0x01 0x00 0x00 0x00 0x00 0xa5 0x00 0x00 0x00 0x01 0x00 0x00 0xa6 0x00 0x00 0x00 0x01 0x00 0x00 0xa7 0x00 0x00 0x00 0x01 0x00 0x00 0xa8 0x00 0x00 0x00 0x01 0x00 0x00 0xa9 0x00 0x01 0x00 0x00 0x00 0x00 0xaa 0x00 0x01 0x00 0x00 0x00 0x00 0xab 0x00 0x00 0x00 0x01 0x00 0x00 0xac 0x00 0x01 0x01 0x01 0x00 0x00 0xad 0x00 0x01 0x00 0x00 0x00 0x00 0xae 0x00 0x01 0x01 0x00 0x00 0x00 0xaf 0x00 0x01 0x00 0x00 0x00 0x00 0xb0 0x00 0x01 0x00 0x00 0x00 0x00 0xb1 0x00 0x01 0x00 0x00 0x00 0x00 0xb2 0x00 0x00 0x00 0x01 0x01 0x00 0xb3 0x00 0x00 0x00 0x01 0x00 0x00>;
		};
	};

	fragment@36 {
		target = <0xffffffff>;

		__overlay__ {
			interrupt-parent = <0xffffffff>;
			interrupts = <0x00 0x02 0x00 0x00>;
			status = "okay";
		};
	};

	fragment@37 {
		target = <0xffffffff>;

		__overlay__ {
			interrupt-parent = <0xffffffff>;
			interrupts = <0x01 0x02 0x01 0x00>;
			status = "okay";
		};
	};

	fragment@38 {
		target = <0xffffffff>;

		__overlay__ {
			interrupt-parent = <0xffffffff>;
			interrupts = <0x07 0x08 0x07 0x00>;
			status = "okay";
		};
	};

	fragment@39 {
		target = <0xffffffff>;

		__overlay__ {
			interrupt-parent = <0xffffffff>;
			interrupts = <0x09 0x02 0x09 0x00>;
			status = "okay";
		};
	};

	fragment@40 {
		target = <0xffffffff>;

		__overlay__ {
			interrupt-parent = <0xffffffff>;
			interrupts = <0x0b 0x02 0x0b 0x00>;
			status = "okay";
		};
	};

	fragment@41 {
		target = <0xffffffff>;

		__overlay__ {
			interrupt-parent = <0xffffffff>;
			interrupts = <0x29 0x02 0x29 0x00>;
			status = "okay";
		};
	};

	fragment@42 {
		target = <0xffffffff>;

		__overlay__ {
			interrupt-parent = <0xffffffff>;
			interrupts = <0x2c 0x01 0x2c 0x00>;
			status = "okay";
		};
	};

	fragment@43 {
		target = <0xffffffff>;

		__overlay__ {
			interrupt-parent = <0xffffffff>;
			interrupts = <0x90 0x04 0x90 0x01>;
			status = "okay";
		};
	};

	fragment@44 {
		target = <0xffffffff>;

		__overlay__ {
			compatible = "mediatek,md1_sim1_hot_plug_eint-eint";
			interrupts = <0x00 0x08>;
			debounce = <0x00 0x2710>;
			dedicated = <0x00 0x00>;
			src_pin = <0x00 0x01>;
			sockettype = <0x00 0x00>;
			status = "okay";
		};
	};

	fragment@45 {
		target = <0xffffffff>;

		__overlay__ {
			compatible = "mediatek,md1_sim2_hot_plug_eint-eint";
			interrupts = <0x01 0x08>;
			debounce = <0x01 0x2710>;
			dedicated = <0x01 0x00>;
			src_pin = <0x01 0x02>;
			sockettype = <0x01 0x00>;
			status = "okay";
		};
	};

	fragment@46 {
		target = <0xffffffff>;

		__overlay__ {
			regulator-name = "vcama";
			regulator-default-on = <0x01>;
			status = "okay";
		};
	};

	fragment@47 {
		target = <0xffffffff>;

		__overlay__ {
			regulator-name = "vsim1";
			regulator-default-on = <0x01>;
			status = "okay";
		};
	};

	fragment@48 {
		target = <0xffffffff>;

		__overlay__ {
			regulator-name = "vsim2";
			regulator-default-on = <0x01>;
			status = "okay";
		};
	};

	fragment@49 {
		target = <0xffffffff>;

		__overlay__ {
			regulator-name = "vcamd";
			regulator-default-on = <0x01>;
			status = "okay";
		};
	};

	fragment@50 {
		target = <0xffffffff>;

		__overlay__ {
			regulator-name = "vcamio";
			regulator-default-on = <0x01>;
			status = "okay";
		};
	};

	fragment@51 {
		target = <0xffffffff>;

		__overlay__ {
			regulator-name = "vldo28";
			regulator-default-on = <0x01>;
			status = "okay";
		};
	};

	fragment@52 {
		target = <0xffffffff>;

		__overlay__ {
			status = "okay";
		};
	};

	fragment@53 {
		target = <0xffffffff>;

		__overlay__ {
			status = "okay";
		};
	};

	fragment@54 {
		target = <0xffffffff>;

		__overlay__ {
			mediatek,kpd-key-debounce = <0x400>;
			mediatek,kpd-sw-pwrkey = <0x74>;
			mediatek,kpd-hw-pwrkey = <0x08>;
			mediatek,kpd-sw-rstkey = <0x72>;
			mediatek,kpd-hw-rstkey = <0x11>;
			mediatek,kpd-use-extend-type = <0x00>;
			mediatek,kpd-hw-map-num = <0x48>;
			mediatek,kpd-hw-init-map = <0x73 0x00 0x00 0x00 0x00 0x00 0x00 0x00 0x00 0x00 0x00 0x00 0x00 0x00 0x00 0x00 0x00 0x00 0x00 0x00 0x00 0x00 0x00 0x00 0x00 0x00 0x00 0x00 0x00 0x00 0x00 0x00 0x00 0x00 0x00 0x00 0x00 0x00 0x00 0x00 0x00 0x00 0x00 0x00 0x00 0x00 0x00 0x00 0x00 0x00 0x00 0x00 0x00 0x00 0x00 0x00 0x00 0x00 0x00 0x00 0x00 0x00 0x00 0x00 0x00 0x00 0x00 0x00 0x00 0x00 0x00 0x00>;
			mediatek,kpd-pwrkey-eint-gpio = <0x00>;
			mediatek,kpd-pwkey-gpio-din = <0x00>;
			mediatek,kpd-hw-dl-key0 = <0x00>;
			mediatek,kpd-hw-dl-key1 = <0x11>;
			mediatek,kpd-hw-dl-key2 = <0x08>;
			mediatek,kpd-hw-recovery-key = <0x00>;
			mediatek,kpd-hw-factory-key = <0x11>;
			status = "okay";
		};
	};

	fragment@55 {
		target = <0xffffffff>;

		__overlay__ {
			cd_level = [01];
		};
	};

	fragment@56 {
		target = <0xffffffff>;

		__overlay__ {
			charger = <0xffffffff>;
		};
	};

	fragment@57 {
		target = <0xffffffff>;

		__overlay__ {
			charger = <0xffffffff>;
			enable_sw_jeita;
		};
	};

	fragment@58 {
		target = <0xffffffff>;

		__overlay__ {
			bc12_active = <0x01>;
		};
	};

	fragment@59 {
		target = <0xffffffff>;

		__overlay__ {
			charger = <0xffffffff>;
			vbus = <0x1c 0x1d>;
			vbus-current;
			vbus-voltage;
			id-gpios = <0xffffffff 0x29 0x00>;
		};
	};

	fragment@60 {
		target = <0xffffffff>;

		__overlay__ {
			mediatek,eye-src = <0x07>;
			mediatek,eye-vrt = <0x01>;
			mediatek,eye-term = <0x01>;
			mediatek,eye-rev6 = <0x01>;
			mediatek,eye-disc = <0x0f>;
			mediatek,host-eye-src = <0x05>;
			mediatek,host-eye-vrt = <0x01>;
			mediatek,host-eye-term = <0x01>;
			mediatek,host-eye-rev6 = <0x01>;
			mediatek,host-eye-disc = <0x0f>;
		};
	};

	fragment@61 {
		target = <0xffffffff>;

		__overlay__ {

			home {
				linux,keycodes = <0x72>;
			};
		};
	};

	fragment@62 {
		target = <0xffffffff>;

		__overlay__ {
			pwr-gpios = <0xffffffff 0xa4 0x00>;
		};
	};

	fragment@63 {
		target = <0xffffffff>;

		__overlay__ {
			pinctrl-names = "aud_clk_mosi_off\0aud_clk_mosi_on\0aud_clk_miso_off\0aud_clk_miso_on\0aud_dat_mosi_off\0aud_dat_mosi_on\0aud_dat_miso_off\0aud_dat_miso_on\0aud_smartpa_off\0aud_smartpa_on\0extamp-pullhigh\0extamp-pulllow";
			pinctrl-10 = <0x1e>;
			pinctrl-11 = <0x1f>;
			status = "okay";
		};
	};

	fragment@64 {
		target = <0xffffffff>;

		__overlay__ {

			audexamphigh {
				phandle = <0x1e>;

				pins_cmd0_dat {
					pinmux = <0x300>;
					slew-rate = <0x01>;
					output-high;
				};

				pins_cmd1_dat {
					pinmux = <0x800>;
					slew-rate = <0x01>;
					output-high;
				};
			};

			audexamplow {
				phandle = <0x1f>;

				pins_cmd0_dat {
					pinmux = <0x300>;
					slew-rate = <0x01>;
					output-low;
				};

				pins_cmd1_dat {
					pinmux = <0x800>;
					slew-rate = <0x01>;
					output-low;
				};
			};
		};
	};

	fragment@65 {
		target = <0xffffffff>;

		__overlay__ {

			camera_pins_cam0_mclk_on {
				phandle = <0x29>;

				pins_cmd_dat {
					pinmux = <0x6401>;
				};
			};

			camera_pins_cam0_mclk_off {
				phandle = <0x2a>;

				pins_cmd_dat {
					pinmux = <0x6400>;
				};
			};

			camera_pins_cam1_mclk_on {
				phandle = <0x2b>;

				pins_cmd_dat {
					pinmux = <0x6c01>;
				};
			};

			camera_pins_cam1_mclk_off {
				phandle = <0x2c>;

				pins_cmd_dat {
					pinmux = <0x6c00>;
				};
			};

			cam0@0 {
				phandle = <0x21>;

				pins_cmd_dat {
					pinmux = <0x6200>;
					slew-rate = <0x01>;
					output-low;
				};
			};

			cam0@1 {
				phandle = <0x22>;

				pins_cmd_dat {
					pinmux = <0x6200>;
					slew-rate = <0x01>;
					output-high;
				};
			};

			cam1@0 {
				phandle = <0x23>;

				pins_cmd_dat {
					pinmux = <0x6d00>;
					slew-rate = <0x01>;
					output-low;
				};
			};

			cam1@1 {
				phandle = <0x24>;

				pins_cmd_dat {
					pinmux = <0x6d00>;
					slew-rate = <0x01>;
					output-high;
				};
			};

			cam0@vcama0 {
				phandle = <0x26>;

				pins_cmd_dat {
					pinmux = <0xa800>;
					slew-rate = <0x01>;
					output-low;
				};
			};

			cam0@vcama1 {
				phandle = <0x25>;

				pins_cmd_dat {
					pinmux = <0xa800>;
					slew-rate = <0x01>;
					output-high;
				};
			};

			cam1@vcama0 {
				phandle = <0x28>;

				pins_cmd_dat {
					pinmux = <0xa800>;
					slew-rate = <0x01>;
					output-low;
				};
			};

			cam1@vcama1 {
				phandle = <0x27>;

				pins_cmd_dat {
					pinmux = <0xa800>;
					slew-rate = <0x01>;
					output-high;
				};
			};

			camdefault {
				phandle = <0x20>;
			};
		};
	};

	fragment@66 {
		target = <0xffffffff>;

		__overlay__ {
			pinctrl-names = "default\0cam0_pnd0\0cam0_pnd1\0cam1_rst0\0cam1_rst1\0cam0_vcama_on\0cam0_vcama_off\0cam1_vcama_on\0cam1_vcama_off\0cam0_mclk_on\0cam0_mclk_off\0cam1_mclk_on\0cam1_mclk_off";
			pinctrl-0 = <0x20>;
			pinctrl-1 = <0x21>;
			pinctrl-2 = <0x22>;
			pinctrl-3 = <0x23>;
			pinctrl-4 = <0x24>;
			pinctrl-5 = <0x25>;
			pinctrl-6 = <0x26>;
			pinctrl-7 = <0x27>;
			pinctrl-8 = <0x28>;
			pinctrl-9 = <0x29>;
			pinctrl-10 = <0x2a>;
			pinctrl-11 = <0x2b>;
			pinctrl-12 = <0x2c>;
			cam0_vcamd-supply = <0xffffffff>;
			cam0_vcamio-supply = <0xffffffff>;
			cam0_vcama-supply = <0xffffffff>;
			cam1_vcamd-supply = <0xffffffff>;
			cam1_vcamio-supply = <0xffffffff>;
			cam1_vcama-supply = <0xffffffff>;
			cam0_enable_sensor = "hi556_mipi_raw";
			cam1_enable_sensor = "hi556_mipi_sub_raw";
			status = "okay";
		};
	};

	fragment@67 {
		target = <0xffffffff>;

		__overlay__ {
			camaf_m1_pmic-supply = <0xffffffff>;
			status = "okay";
		};
	};

	fragment@68 {
		target = <0xffffffff>;

		__overlay__ {

			sgm4154x@1A {
				status = "okay";
				compatible = "sgm,sgm4154x";
				reg = <0x1a>;
				interrupt-parent = <0xffffffff>;
				interrupts = <0x0b 0x00>;
				sgm,irq-gpio = <0xffffffff 0x0b 0x00>;
				sgm,chg-en-gpio = <0xffffffff 0x9a 0x00>;
				enable_sw_jeita;
				jeita_temp_above_t4_cv = <0x3e8fa0>;
				jeita_temp_t3_to_t4_cv = <0x3e8fa0>;
				jeita_temp_t2_to_t3_cv = <0x426030>;
				jeita_temp_t1_to_t2_cv = <0x426030>;
				jeita_temp_t0_to_t1_cv = <0x426030>;
				jeita_temp_below_t0_cv = <0x426030>;
				jeita_temp_above_t4_cc_current = <0x00>;
				jeita_temp_t3_to_t4_cc_current = <0xf4240>;
				jeita_temp_t2_to_t3_cc_current = <0x1e8480>;
				jeita_temp_t1_to_t2_cc_current = <0xf4240>;
				jeita_temp_t0_to_t1_cc_current = <0x00>;
				jeita_temp_below_t0_cc_current = <0x00>;
				temp_t4_thres = <0x37>;
				temp_t4_thres_minus_x_degree = <0x30>;
				temp_t3_thres = <0x2d>;
				temp_t3_thres_minus_x_degree = <0x2c>;
				temp_t2_thres = <0x0a>;
				temp_t2_thres_plus_x_degree = <0x10>;
				temp_t1_thres = <0x00>;
				temp_t1_thres_plus_x_degree = <0x02>;
				temp_t0_thres = <0x00>;
				temp_t0_thres_plus_x_degree = <0x00>;
				temp_neg_10_thres = <0x00>;
				phandle = <0x55>;

				sgm-otg-vbus {
					regulator-compatible = "sgm-otg-vbus";
					regulator-name = "usb-otg-vbus";
					regulator-min-microvolt = <0x4c4b40>;
					regulator-max-microvolt = <0x4c4b40>;
					phandle = <0x1c>;
				};
			};

			sc8960x@6B {
				compatible = "sc,sc89601d";
				reg = <0x6b>;
				interrupt-parent = <0xffffffff>;
				interrupts = <0x0b 0x00>;
				sc,irq-gpio = <0xffffffff 0x0b 0x00>;
				charger_name = "primary_chg";
				sc,sc8960x,charge-detect-enable;
				sc,sc8960x,usb-vlim = <0x11f8>;
				sc,sc8960x,usb-ilim = <0x1f4>;
				sc,sc8960x,usb-vreg = <0x1130>;
				sc,sc8960x,usb-ichg = <0x1f4>;
				sc,sc8960x,precharge-current = <0x100>;
				sc,sc8960x,termination-current = <0xf0>;
				sc,sc8960x,boost-voltage = <0x1386>;
				sc,sc8960x,boost-current = <0x708>;
				sc,sc8960x,enable_term;
				sc,sc8960x,stat-pin-ctrl = <0x03>;
				sc,sc8960x,vac-ovp-threshold = <0x2904>;

				sc-otg-vbus {
					regulator-compatible = "sc-otg-vbus";
					regulator-name = "usb-otg-vbus";
					regulator-min-microvolt = <0x4c4b40>;
					regulator-max-microvolt = <0x4c4b40>;
					phandle = <0x1d>;
				};
			};
		};
	};

	fragment@69 {
		target = <0xffffffff>;

		__overlay__ {
			min_charger_voltage = <0x419ce0>;
			fast_charge_voltage = <0x1e8480>;
			ac_charger_current = <0x1e8480>;
			ac_charger_input_current = <0x1e8480>;
			ta_ac_charger_current = <0x1e8480>;
			pd_charger_current = <0x30d40>;
		};
	};

	fragment@70 {
		target = <0xffffffff>;

		__overlay__ {
			battery_cv = <0x426030>;
			ac_charger_current = <0x2191c0>;
			ac_charger_input_current = <0x1e8480>;
			charging_host_charger_current = <0x16e360>;
		};
	};

	fragment@71 {
		target = <0xffffffff>;

		__overlay__ {
			clock-frequency = <0x186a0>;

			ocp2131@3e {
				compatible = "ocp2131";
				reg = <0x3e>;
				status = "okay";
			};
		};
	};

	fragment@72 {
		target = <0xffffffff>;

		__overlay__ {

			lcm_rst_out1_gpio {
				phandle = <0x2d>;

				pins_cmd_dat {
					pinmux = <0x2d00>;
					slew-rate = <0x01>;
					output-high;
				};
			};

			lcm_rst_out0_gpio {
				phandle = <0x2e>;

				pins_cmd_dat {
					pinmux = <0x2d00>;
					slew-rate = <0x01>;
					output-low;
				};
			};

			lcd_bias_enp0_gpio {
				phandle = <0x31>;

				pins_cmd_dat {
					pinmux = <0x9600>;
					slew-rate = <0x01>;
					output-low;
				};
			};

			lcd_bias_enp1_gpio {
				phandle = <0x32>;

				pins_cmd_dat {
					pinmux = <0x9600>;
					slew-rate = <0x01>;
					output-high;
				};
			};

			lcd_bias_enn0_gpio {
				phandle = <0x2f>;

				pins_cmd_dat {
					pinmux = <0xaf00>;
					slew-rate = <0x01>;
					output-low;
				};
			};

			lcd_bias_enn1_gpio {
				phandle = <0x30>;

				pins_cmd_dat {
					pinmux = <0xaf00>;
					slew-rate = <0x01>;
					output-high;
				};
			};
		};
	};

	fragment@73 {
		target = <0xffffffff>;

		__overlay__ {
			pinctrl-names = "lcm_rst_out1_gpio\0lcm_rst_out0_gpio\0lcd_bias_enn0_gpio\0lcd_bias_enn1_gpio\0lcd_bias_enp0_gpio\0lcd_bias_enp1_gpio";
			pinctrl-0 = <0x2d>;
			pinctrl-1 = <0x2e>;
			pinctrl-2 = <0x2f>;
			pinctrl-3 = <0x30>;
			pinctrl-4 = <0x31>;
			pinctrl-5 = <0x32>;
			status = "okay";
		};
	};

	fragment@74 {
		target = <0xffffffff>;

		__overlay__ {
			status = "okay";
			#address-cells = <0x01>;
			#size-cells = <0x00>;

			himax_touch@0 {
				compatible = "himax,hxcommon";
				reg = <0x00>;
				spi-max-frequency = <0x989680>;
				status = "okay";
			};
		};
	};

	fragment@75 {
		target = <0xffffffff>;

		__overlay__ {
			tpd-resolution = <0x4b0 0x7d0>;
			interrupt-parent = <0xffffffff>;
			interrupts = <0x00 0x02 0x00 0x00>;
			use-tpd-button = <0x00>;
			tpd-key-num = <0x03>;
			tpd-key-local = <0x8b 0xac 0x9e 0x00>;
			tpd-key-dim-local = <0x5a 0x373 0x64 0x28 0xe6 0x373 0x64 0x28 0x172 0x373 0x64 0x28 0x00 0x00 0x00 0x00>;
			tpd-max-touch-num = <0x0a>;
			tpd-filter-enable = <0x00>;
			tpd-filter-pixel-density = <0x6a>;
			tpd-filter-custom-prameters = <0x00 0x00 0x00 0x00 0x00 0x00 0x00 0x00 0x00 0x00 0x00 0x00>;
			tpd-filter-custom-speed = <0x00 0x00 0x00>;
			pinctrl-names = "default\0state_eint_as_int\0state_eint_output0\0state_eint_output1\0state_rst_output0\0state_rst_output1\0state_spi_mode";
			pinctrl-0 = <0x33>;
			pinctrl-1 = <0x34>;
			pinctrl-2 = <0x35>;
			pinctrl-3 = <0x36>;
			pinctrl-4 = <0x37>;
			pinctrl-5 = <0x38>;
			pinctrl-6 = <0x39>;
			status = "okay";
		};
	};

	fragment@76 {
		target = <0xffffffff>;

		__overlay__ {

			eint0default {
				phandle = <0x33>;
			};

			eint1touch@0 {
				phandle = <0x34>;

				pins_cmd_dat {
					pinmux = <0x00>;
					slew-rate = <0x00>;
					bias-disable;
				};
			};

			eintoutput0 {
				phandle = <0x35>;

				pins_cmd_dat {
					pinmux = <0x00>;
					slew-rate = <0x01>;
					output-low;
				};
			};

			eintoutput1 {
				phandle = <0x36>;

				pins_cmd_dat {
					pinmux = <0x00>;
					slew-rate = <0x01>;
					output-high;
				};
			};

			rstoutput0 {
				phandle = <0x37>;

				pins_cmd_dat {
					pinmux = <0xae00>;
					slew-rate = <0x01>;
					output-low;
				};
			};

			rstoutput1 {
				phandle = <0x38>;

				pins_cmd_dat {
					pinmux = <0xae00>;
					slew-rate = <0x01>;
					output-high;
				};
			};

			spimode_default {
				phandle = <0x39>;

				pins_cmd_dat {
					pinmux = <0x1501 0x1601 0x1701 0x1801>;
					drive-strength = <0x04>;
				};
			};
		};
	};

	fragment@77 {
		target = <0xffffffff>;

		__overlay__ {

			fm_lna {
				status = "okay";
				compatible = "tinno,fm_lna";
				tinno,lna-en-gpio = <0xffffffff 0xa3 0x00>;
				phandle = <0x56>;
			};
		};
	};

	__symbols__ {
		led0 = "/fragment@1/__overlay__/led@0";
		led1 = "/fragment@1/__overlay__/led@1";
		led2 = "/fragment@1/__overlay__/led@2";
		led3 = "/fragment@1/__overlay__/led@3";
		led4 = "/fragment@1/__overlay__/led@4";
		led5 = "/fragment@1/__overlay__/led@5";
		led6 = "/fragment@1/__overlay__/led@6";
		panel = "/fragment@1/__overlay__/panel@0";
		vibrator0 = "/fragment@1/__overlay__/vibrator@0";
		lcd_disp_pwm = "/fragment@2/__overlay__/lcd_disp_pwm";
		lcd_disp_pwm_gpio = "/fragment@2/__overlay__/lcd_disp_pwm_gpio";
		consys_pins_default = "/fragment@6/__overlay__/consys_default";
		gpslna_pins_init = "/fragment@6/__overlay__/gpslna@0";
		gpslna_pins_oh = "/fragment@6/__overlay__/gpslna@1";
		gpslna_pins_ol = "/fragment@6/__overlay__/gpslna@2";
		accdet_pins_default = "/fragment@9/__overlay__/accdetdefault";
		accdet_pins_eint_as_int = "/fragment@9/__overlay__/accdeteint@0";
		fingerprint_default = "/fragment@12/__overlay__/state_default";
		fingerprint_reset_high = "/fragment@12/__overlay__/state_reset_high";
		fingerprint_reset_low = "/fragment@12/__overlay__/state_reset_low";
		irtx_gpio_led_default = "/fragment@14/__overlay__/irtx_gpio_led_def@gpio90";
		irtx_gpio_led_set = "/fragment@14/__overlay__/irtx_gpio_led_set@gpio90";
		aud_clk_mosi_off = "/fragment@16/__overlay__/aud_clk_mosi_off";
		aud_clk_mosi_on = "/fragment@16/__overlay__/aud_clk_mosi_on";
		aud_clk_miso_off = "/fragment@16/__overlay__/aud_clk_miso_off";
		aud_clk_miso_on = "/fragment@16/__overlay__/aud_clk_miso_on";
		aud_dat_mosi_off = "/fragment@16/__overlay__/aud_dat_mosi_off";
		aud_dat_mosi_on = "/fragment@16/__overlay__/aud_dat_mosi_on";
		aud_dat_miso_off = "/fragment@16/__overlay__/aud_dat_miso_off";
		aud_dat_miso_on = "/fragment@16/__overlay__/aud_dat_miso_on";
		aud_pins_smartpa_off = "/fragment@16/__overlay__/aud_pins_smartpa_off";
		aud_pins_smartpa_on = "/fragment@16/__overlay__/aud_pins_smartpa_on";
		kpd_pins_default = "/fragment@18/__overlay__/kpdgpiodefault";
		flashlights_sywt78 = "/fragment@19/__overlay__/flashlights_sywt78";
		flash_default = "/fragment@20/__overlay__/flash_default";
		torch_en_pin0 = "/fragment@20/__overlay__/torch_en_pin0";
		torch_en_pin1 = "/fragment@20/__overlay__/torch_en_pin1";
		cap_touch_mtk = "/fragment@24/__overlay__/cap_touch@38";
		camera_main_mtk = "/fragment@26/__overlay__/camera_main@1a";
		camera_main_eeprom_mtk = "/fragment@26/__overlay__/camera_main_eeprom@50";
		camera_main_af_mtk = "/fragment@26/__overlay__/camera_main_af@0c";
		ccu_sensor_i2c_2_hw_mtk = "/fragment@26/__overlay__/ccu_sensor_i2c_2_hw@10";
		speaker_amp_mtk = "/fragment@27/__overlay__/speaker_amp@34";
		slave_charger_mtk = "/fragment@27/__overlay__/slave_charger@4b";
		nfc_mtk = "/fragment@27/__overlay__/nfc@08";
		ext_buck_lp4_mtk = "/fragment@27/__overlay__/ext_buck_lp4@57";
		ext_buck_lp4x_mtk = "/fragment@27/__overlay__/ext_buck_lp4x@50";
		camera_sub_mtk = "/fragment@28/__overlay__/camera_sub@2e";
		camera_sub_eeprom_mtk = "/fragment@28/__overlay__/camera_sub_eeprom@52";
		ccu_sensor_i2c_4_hw_mtk = "/fragment@28/__overlay__/ccu_sensor_i2c_4_hw@11";
		camera_main_two_mtk = "/fragment@30/__overlay__/camera_main_two@2d";
		camera_main_two_eeprom_mtk = "/fragment@30/__overlay__/camera_main_two_eeprom@50";
		camera_main_two_af_mtk = "/fragment@30/__overlay__/camera_main_two_af@0c";
		ext_buck_vgpu_mtk = "/fragment@30/__overlay__/ext_buck_vgpu@55";
		aud_pins_extamp_high = "/fragment@64/__overlay__/audexamphigh";
		aud_pins_extamp_low = "/fragment@64/__overlay__/audexamplow";
		camera_pins_cam0_mclk_on = "/fragment@65/__overlay__/camera_pins_cam0_mclk_on";
		camera_pins_cam0_mclk_off = "/fragment@65/__overlay__/camera_pins_cam0_mclk_off";
		camera_pins_cam1_mclk_on = "/fragment@65/__overlay__/camera_pins_cam1_mclk_on";
		camera_pins_cam1_mclk_off = "/fragment@65/__overlay__/camera_pins_cam1_mclk_off";
		camera_pins_cam0_pnd0 = "/fragment@65/__overlay__/cam0@0";
		camera_pins_cam0_pnd1 = "/fragment@65/__overlay__/cam0@1";
		camera_pins_cam1_rst0 = "/fragment@65/__overlay__/cam1@0";
		camera_pins_cam1_rst1 = "/fragment@65/__overlay__/cam1@1";
		camera_pins_cam_ldo_rear_vcama_0 = "/fragment@65/__overlay__/cam0@vcama0";
		camera_pins_cam_ldo_rear_vcama_1 = "/fragment@65/__overlay__/cam0@vcama1";
		camera_pins_cam_ldo_front_vcama_0 = "/fragment@65/__overlay__/cam1@vcama0";
		camera_pins_cam_ldo_front_vcama_1 = "/fragment@65/__overlay__/cam1@vcama1";
		camera_pins_default = "/fragment@65/__overlay__/camdefault";
		sgm4154x = "/fragment@68/__overlay__/sgm4154x@1A";
		sgm_otg_vbus = "/fragment@68/__overlay__/sgm4154x@1A/sgm-otg-vbus";
		sc_otg_vbus = "/fragment@68/__overlay__/sc8960x@6B/sc-otg-vbus";
		mtkfb_pins_lcm_rst_out1_gpio = "/fragment@72/__overlay__/lcm_rst_out1_gpio";
		mtkfb_pins_lcm_rst_out0_gpio = "/fragment@72/__overlay__/lcm_rst_out0_gpio";
		mtkfb_pins_lcd_bias_enp0 = "/fragment@72/__overlay__/lcd_bias_enp0_gpio";
		mtkfb_pins_lcd_bias_enp1 = "/fragment@72/__overlay__/lcd_bias_enp1_gpio";
		mtkfb_pins_lcd_bias_enn0 = "/fragment@72/__overlay__/lcd_bias_enn0_gpio";
		mtkfb_pins_lcd_bias_enn1 = "/fragment@72/__overlay__/lcd_bias_enn1_gpio";
		ctp_pins_default = "/fragment@76/__overlay__/eint0default";
		ctp_pins_eint_as_int = "/fragment@76/__overlay__/eint1touch@0";
		ctp_pins_eint_output0 = "/fragment@76/__overlay__/eintoutput0";
		ctp_pins_eint_output1 = "/fragment@76/__overlay__/eintoutput1";
		ctp_pins_rst_output0 = "/fragment@76/__overlay__/rstoutput0";
		ctp_pins_rst_output1 = "/fragment@76/__overlay__/rstoutput1";
		ctp_pins_spi_mode = "/fragment@76/__overlay__/spimode_default";
		fm_lna = "/fragment@77/__overlay__/fm_lna";
	};

	__fixups__ {
		chosen = "/fragment@0:target:0";
		odm = "/fragment@1:target:0\0/fragment@19:target:0\0/fragment@77:target:0";
		pio = "/fragment@1/__overlay__/panel@0:gpio_lcd_rst:0\0/fragment@1/__overlay__/panel@0:gpio_lcd_led_en:0\0/fragment@1/__overlay__/panel@0:gpio_lcd_pwr_enp:0\0/fragment@1/__overlay__/panel@0:gpio_lcd_pwr_enn:0\0/fragment@2:target:0\0/fragment@5/__overlay__/sgm7220@47:interrupt-parent:0\0/fragment@5/__overlay__/sgm7220@47:sgm7220,int-gpio:0\0/fragment@5/__overlay__/wusb3801@60:interrupt-parent:0\0/fragment@5/__overlay__/wusb3801@60:wusb3801,int-gpio:0\0/fragment@6:target:0\0/fragment@9:target:0\0/fragment@12:target:0\0/fragment@14:target:0\0/fragment@16:target:0\0/fragment@18:target:0\0/fragment@20:target:0\0/fragment@34/__overlay__:GPIO_SIM2_SIO:0\0/fragment@34/__overlay__:GPIO_SIM2_SRST:0\0/fragment@34/__overlay__:GPIO_SIM2_SCLK:0\0/fragment@34/__overlay__:GPIO_SIM1_SCLK:0\0/fragment@34/__overlay__:GPIO_SIM1_SRST:0\0/fragment@34/__overlay__:GPIO_SIM1_SIO:0\0/fragment@34/__overlay__:GPIO_SIM2_HOT_PLUG:0\0/fragment@34/__overlay__:GPIO_SIM1_HOT_PLUG:0\0/fragment@36/__overlay__:interrupt-parent:0\0/fragment@37/__overlay__:interrupt-parent:0\0/fragment@38/__overlay__:interrupt-parent:0\0/fragment@39/__overlay__:interrupt-parent:0\0/fragment@40/__overlay__:interrupt-parent:0\0/fragment@41/__overlay__:interrupt-parent:0\0/fragment@42/__overlay__:interrupt-parent:0\0/fragment@43/__overlay__:interrupt-parent:0\0/fragment@59/__overlay__:id-gpios:0\0/fragment@62/__overlay__:pwr-gpios:0\0/fragment@64:target:0\0/fragment@65:target:0\0/fragment@68/__overlay__/sgm4154x@1A:interrupt-parent:0\0/fragment@68/__overlay__/sgm4154x@1A:sgm,irq-gpio:0\0/fragment@68/__overlay__/sgm4154x@1A:sgm,chg-en-gpio:0\0/fragment@68/__overlay__/sc8960x@6B:interrupt-parent:0\0/fragment@68/__overlay__/sc8960x@6B:sc,irq-gpio:0\0/fragment@72:target:0\0/fragment@75/__overlay__:interrupt-parent:0\0/fragment@76:target:0\0/fragment@77/__overlay__/fm_lna:tinno,lna-en-gpio:0";
		i2c3 = "/fragment@3:target:0\0/fragment@27:target:0";
		i2c6 = "/fragment@4:target:0\0/fragment@30:target:0";
		i2c5 = "/fragment@5:target:0\0/fragment@29:target:0\0/fragment@68:target:0";
		consys = "/fragment@7:target:0";
		accdet = "/fragment@8:target:0";
		spi0 = "/fragment@10:target:0";
		goodix_fp = "/fragment@11:target:0";
		irtx_pwm = "/fragment@13:target:0";
		audgpio = "/fragment@15:target:0\0/fragment@63:target:0";
		keypad = "/fragment@17:target:0\0/fragment@54:target:0";
		auxadc = "/fragment@21:target:0\0/fragment@22/__overlay__:io-channels:0";
		md_auxadc = "/fragment@22:target:0";
		pmic_clock_buffer_ctrl = "/fragment@23:target:0";
		i2c0 = "/fragment@24:target:0\0/fragment@71:target:0";
		i2c1 = "/fragment@25:target:0";
		i2c2 = "/fragment@26:target:0";
		i2c4 = "/fragment@28:target:0";
		i2c7 = "/fragment@31:target:0";
		i2c8 = "/fragment@32:target:0";
		i2c9 = "/fragment@33:target:0";
		gpio_usage_mapping = "/fragment@34:target:0";
		gpio = "/fragment@35:target:0";
		touch = "/fragment@36:target:0\0/fragment@53:target:0\0/fragment@75:target:0";
		msdc1_ins = "/fragment@37:target:0";
		smart_pa = "/fragment@38:target:0";
		tcpc_pd = "/fragment@39:target:0";
		subpmic_pmu_eint = "/fragment@40:target:0";
		otg_iddig = "/fragment@41:target:0";
		dsi_te = "/fragment@42:target:0";
		main_pmic = "/fragment@43:target:0";
		md1_sim1_hot_plug_eint = "/fragment@44:target:0";
		md1_sim2_hot_plug_eint = "/fragment@45:target:0";
		mt_pmic_vcama_ldo_reg = "/fragment@46:target:0\0/fragment@66/__overlay__:cam0_vcama-supply:0\0/fragment@66/__overlay__:cam1_vcama-supply:0";
		mt_pmic_vsim1_ldo_reg = "/fragment@47:target:0";
		mt_pmic_vsim2_ldo_reg = "/fragment@48:target:0";
		mt_pmic_vcamd_ldo_reg = "/fragment@49:target:0\0/fragment@66/__overlay__:cam0_vcamd-supply:0\0/fragment@66/__overlay__:cam1_vcamd-supply:0";
		mt_pmic_vcamio_ldo_reg = "/fragment@50:target:0\0/fragment@66/__overlay__:cam0_vcamio-supply:0\0/fragment@66/__overlay__:cam1_vcamio-supply:0";
		mt_pmic_vldo28_ldo_reg = "/fragment@51:target:0\0/fragment@67/__overlay__:camaf_m1_pmic-supply:0";
		kd_camera_hw1 = "/fragment@52:target:0\0/fragment@66:target:0";
		msdc1 = "/fragment@55:target:0\0/fragment@62:target:0";
		mtk_gauge = "/fragment@56:target:0";
		mtk_charger_type = "/fragment@56/__overlay__:charger:0\0/fragment@57/__overlay__:charger:0\0/fragment@58:target:0\0/fragment@59/__overlay__:charger:0";
		charger = "/fragment@57:target:0\0/fragment@70:target:0";
		extcon_usb = "/fragment@59:target:0";
		u2port0 = "/fragment@60:target:0";
		mt6357keys = "/fragment@61:target:0";
		camera_af_hw_node = "/fragment@67:target:0";
		lk_charger = "/fragment@69:target:0";
		mtkfb = "/fragment@73:target:0";
		spi3 = "/fragment@74:target:0";
	};

	__local_fixups__ {

		fragment@1 {

			__overlay__ {

				panel@0 {
					pinctrl-0 = <0x00>;
					pinctrl-1 = <0x00>;
				};
			};
		};

		fragment@7 {

			__overlay__ {
				pinctrl-0 = <0x00>;
				pinctrl-1 = <0x00>;
				pinctrl-2 = <0x00>;
				pinctrl-3 = <0x00>;
			};
		};

		fragment@8 {

			__overlay__ {
				pinctrl-0 = <0x00>;
				pinctrl-1 = <0x00>;
			};
		};

		fragment@11 {

			__overlay__ {
				pinctrl-0 = <0x00>;
				pinctrl-1 = <0x00>;
				pinctrl-2 = <0x00>;
			};
		};

		fragment@13 {

			__overlay__ {
				pinctrl-0 = <0x00>;
				pinctrl-1 = <0x00>;
			};
		};

		fragment@15 {

			__overlay__ {
				pinctrl-0 = <0x00>;
				pinctrl-1 = <0x00>;
				pinctrl-2 = <0x00>;
				pinctrl-3 = <0x00>;
				pinctrl-4 = <0x00>;
				pinctrl-5 = <0x00>;
				pinctrl-6 = <0x00>;
				pinctrl-7 = <0x00>;
				pinctrl-8 = <0x00>;
				pinctrl-9 = <0x00>;
			};
		};

		fragment@17 {

			__overlay__ {
				pinctrl-0 = <0x00>;
			};
		};

		fragment@19 {

			__overlay__ {

				flashlights_sywt78 {
					pinctrl-0 = <0x00>;
					pinctrl-1 = <0x00>;
					pinctrl-2 = <0x00>;
				};
			};
		};

		fragment@59 {

			__overlay__ {
				vbus = <0x00 0x04>;
			};
		};

		fragment@63 {

			__overlay__ {
				pinctrl-10 = <0x00>;
				pinctrl-11 = <0x00>;
			};
		};

		fragment@66 {

			__overlay__ {
				pinctrl-0 = <0x00>;
				pinctrl-1 = <0x00>;
				pinctrl-2 = <0x00>;
				pinctrl-3 = <0x00>;
				pinctrl-4 = <0x00>;
				pinctrl-5 = <0x00>;
				pinctrl-6 = <0x00>;
				pinctrl-7 = <0x00>;
				pinctrl-8 = <0x00>;
				pinctrl-9 = <0x00>;
				pinctrl-10 = <0x00>;
				pinctrl-11 = <0x00>;
				pinctrl-12 = <0x00>;
			};
		};

		fragment@73 {

			__overlay__ {
				pinctrl-0 = <0x00>;
				pinctrl-1 = <0x00>;
				pinctrl-2 = <0x00>;
				pinctrl-3 = <0x00>;
				pinctrl-4 = <0x00>;
				pinctrl-5 = <0x00>;
			};
		};

		fragment@75 {

			__overlay__ {
				pinctrl-0 = <0x00>;
				pinctrl-1 = <0x00>;
				pinctrl-2 = <0x00>;
				pinctrl-3 = <0x00>;
				pinctrl-4 = <0x00>;
				pinctrl-5 = <0x00>;
				pinctrl-6 = <0x00>;
			};
		};
	};
};
